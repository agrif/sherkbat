/dts-v1/;
/plugin/;

/* device tree overlay for raspberry pi */

/ {
    compatible = "brcm,bcm2835";

    fragment@0 {
        target = <&i2c>;
        __overlay__ {
            sherkbat@40 {
                compatible = "sherkbat";
                reg = <0x40>;
            };
        };
    };
};
